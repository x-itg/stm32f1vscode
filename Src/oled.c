#include "oled.h"
#include "ec20.h"
 
const unsigned char F6x8[][6] =		
{
  0x00, 0x00, 0x00, 0x00, 0x00, 0x00,// sp
  0x00, 0x00, 0x00, 0x2f, 0x00, 0x00,// !
  0x00, 0x00, 0x07, 0x00, 0x07, 0x00,// "
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  0x14, 0x14, 0x14, 0x14, 0x14, 0x14,// horiz lines
};

/****************************************8*16的点阵************************************/
const unsigned char F8X16[]=	  
{
  0x00,0x00,0x00,0x00,0x00,0x00,0x00,0x00,0x00,0x00,0x00,0x00,0x00,0x00,0x00,0x00,// 0
  0x00,0x00,0x00,0xF8,0x00,0x00,0x00,0x00,0x00,0x00,0x00,0x33,0x30,0x00,0x00,0x00,//! 1
  0x00,0x10,0x0C,0x06,0x10,0x0C,0x06,0x00,0x00,0x00,0x00,0x00,0x00,0x00,0x00,0x00,//" 2
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  0x00,0x06,0x01,0x01,0x02,0x02,0x04,0x04,0x00,0x00,0x00,0x00,0x00,0x00,0x00,0x00,//~ 94
};



static void delay_us(unsigned int us)
{    
  unsigned int i=0;

  for(;i<us;)
  {
    i++;

  }

  
}


void delay_oledms(unsigned int ms)
{
  while(ms > 0)
  {
    ms--;
    delay_us(998);
  }
}


void WriteCmd(unsigned char IIC_Cmd)
{
#if DEBUGMODE==0//架空这个函数
  uint8_t *pData;
  pData = &IIC_Cmd;
  HAL_I2C_Mem_Write(&hi2c1,OLED_ADDRESS,0x00,I2C_MEMADD_SIZE_8BIT,pData,1,100);
#endif
  
  
}
//------------------------------------------------------
//写数据
//------------------------------------------------------
void WriteDat(unsigned char IIC_Dat)
{
 #if DEBUGMODE==0//架空这个函数
  uint8_t *pData;
  pData = &IIC_Dat;
  HAL_I2C_Mem_Write(&hi2c1,OLED_ADDRESS,0x40,I2C_MEMADD_SIZE_8BIT,pData,1,100);
#endif
  
}
//-----------------------------------------------------
//OLED初始化
//-----------------------------------------------------
void OLED_Init(void)
{
  delay_oledms(500);
#if 0
  WriteCmd(0xae);
  WriteCmd(0x00);
  WriteCmd(0x10);
  WriteCmd(0x40);
  WriteCmd(0x81);
  WriteCmd(0xcf);
  WriteCmd(0xa1);
  WriteCmd(0xc8);
  WriteCmd(0xa6);
  WriteCmd(0xa8);
  WriteCmd(0x3f);
  WriteCmd(0xd3);
  WriteCmd(0x00);
  WriteCmd(0xd5);
  WriteCmd(0x80);
  WriteCmd(0xd9);
  WriteCmd(0xf1);
  WriteCmd(0xda);
  WriteCmd(0x12);
  WriteCmd(0xdb);
  WriteCmd(0x40);
  WriteCmd(0x20);
  WriteCmd(0x02);
  WriteCmd(0x8d);
  WriteCmd(0x14);
  WriteCmd(0xa4);
  WriteCmd(0xa6);
  WriteCmd(0xaf);
#endif 
  WriteCmd(0xAE);//1?±???ê?
  WriteCmd(0x40);//---set low column address
  WriteCmd(0xB0);//---set high column addres
  WriteCmd(0xC8);//-not offset
  WriteCmd(0x81);//éè????±è?è
  WriteCmd(0xff);
  WriteCmd(0xa1);//?????¨?òéè??
  WriteCmd(0xa6);
  WriteCmd(0xa8);
  WriteCmd(0x1f);
  WriteCmd(0xd3);
  WriteCmd(0x00);
  WriteCmd(0xd5);
  WriteCmd(0xf0);
  WriteCmd(0xd9);
  WriteCmd(0x22);
  WriteCmd(0xda);
  WriteCmd(0x02);
  WriteCmd(0xdb);
  WriteCmd(0x49);
  WriteCmd(0x8d);
  WriteCmd(0x14);
  WriteCmd(0xaf);
  OLED_CLS();
}


//-----------------------------------------------------------------------
//OLED全屏填充
//----------------------------------------------------------------------
void OLED_Fill(unsigned char fill_Data)
{

  unsigned char m,n;
  for(m=0;m<8;m++)
  {
    WriteCmd(0xb0+m);
    WriteCmd(0x00);
    WriteCmd(0x10);
    for(n=0;n<128;n++)
    {
      WriteDat(fill_Data);
    }
  }

}
//--------------------------------------------------------------
void OLED_CLS(void)
{

  OLED_Fill(0x00);

}
 
void OLED_ON(void)
{

  WriteCmd(0x8d);
  WriteCmd(0x10);
  WriteCmd(0xae);

}



void OLED_OFF(void)
{

  WriteCmd(0x8d);
  WriteCmd(0x10);
  WriteCmd(0xae);

}


//----------------------------------------------------------------------
//设置坐标
//----------------------------------------------------------------------
void OLED_Set_Pos(unsigned char x, unsigned char y) 
{

  WriteCmd(0xb0+y);
  delay_us(DELAYUS);
  WriteCmd(((x&0xf0)>>4)|0x10);
  delay_us(DELAYUS);
  WriteCmd((x&0x0f)); 
  delay_us(DELAYUS);

}   

//显示汉字
//-----------------------------------------------------------------------------
void OLED_WR_Byte(unsigned dat,unsigned cmd)
{

  if(cmd)
  {
    WriteDat(dat);
  }
  else 
  {
    WriteCmd(dat); 
  }

}

//清屏函数,清完屏,整个屏幕是黑色的!和没点亮一样!!!	  
void OLED_Clear(void)  
{

  unsigned char i,n;		    
  for(i=0;i<8;i++)  
  {  
    OLED_WR_Byte (0xb0+i,OLED_CMD);    //设置页地址（0~7）
    OLED_WR_Byte (0x00,OLED_CMD);      //设置显示位置—列低地址
    OLED_WR_Byte (0x10,OLED_CMD);      //设置显示位置—列高地址   
    for(n=0;n<128;n++)OLED_WR_Byte(0,OLED_DATA); 
  } //更新显示

}
//在指定位置显示一个字符,包括部分字符
//x:0~127
//y:0~63
//mode:0,反白显示;1,正常显示				 
//size:选择字体 16/12  
void OLED_ShowChar(unsigned char x,unsigned char y,unsigned char chr,unsigned char Char_Size)
{ 

  unsigned char c=0,i=0;	
  c=chr-' ';//得到偏移后的值			
  if(x>Max_Column-1){x=0;y=y+2;}
  if(Char_Size ==16)
  {
    OLED_Set_Pos(x,y);	
    for(i=0;i<8;i++)
      OLED_WR_Byte(F8X16[c*16+i],OLED_DATA);
    OLED_Set_Pos(x,y+1);
    for(i=0;i<8;i++)
      OLED_WR_Byte(F8X16[c*16+i+8],OLED_DATA);
  }
  else {	
    OLED_Set_Pos(x,y);
    for(i=0;i<6;i++)
      OLED_WR_Byte(F6x8[c][i],OLED_DATA);
    
  }

}

 
//显示一个字符号串
void OLED_ShowString(unsigned char x,unsigned char y, char *chr,unsigned char Char_Size)
{

  unsigned char j=0;
  while (chr[j]!='\0')
  {		
    if(chr[j]!='\r'&&chr[j]!='\n')
    {
      OLED_ShowChar(x,y,chr[j],Char_Size);
      x+=8;
      if(x>120)
      {
        x=0;y+=2;
      }
    }
    j++;
  }


}
//8x16  高16 
void OLED_ShowCharNomAndRev(unsigned char x,unsigned char y,unsigned char chr,unsigned char rev)
{     
  

  unsigned char c=0,i=0;	
  c=chr-' ';//得到偏移后的值			
  if(x>128-1){x=0;y=y+2;}//最多128列
  if(rev ==0)
  {
    OLED_Set_Pos(x,y);	
    for(i=0;i<8;i++)
      WriteDat(F8X16[c*16+i]);
    OLED_Set_Pos(x,y+1);
    for(i=0;i<8;i++)
      WriteDat(F8X16[c*16+i+8]);
  }
  else 
  {	
    OLED_Set_Pos(x,y);	
    for(i=0;i<8;i++)
      WriteDat(~F8X16[c*16+i]);
    OLED_Set_Pos(x,y+1);
    for(i=0;i<8;i++)
      WriteDat(~F8X16[c*16+i+8]);
  }
  

}
typedef struct gbx16         // 汉字字模数据结构
{
	char Index[2];
	char Msk[32];
}GBX16;
const GBX16 Hzk[]={

  //纵向8点下高位
"正", 0x00,0x02,0x02,0xC2,0x02,0x02,0x02,0xFE,
      0x82,0x82,0x82,0xC2,0x83,0x02,0x00,0x00,
      0x40,0x40,0x40,0x7F,0x40,0x40,0x40,0x7F,
      0x40,0x40,0x40,0x40,0x40,0x60,0x40,0x00,

"在", 0x08,0x08,0x08,0x08,0xC8,0x38,0x0F,0x08,
      0x08,0xE8,0x08,0x88,0x08,0x0C,0x08,0x00,
      0x08,0x04,0x02,0xFF,0x00,0x40,0x41,0x41,
      0x41,0x7F,0x41,0x41,0x41,0x60,0x40,0x00,

"连", 0x40,0x42,0xCC,0x00,0x04,0x44,0x64,0x5C,
      0x47,0xF4,0x44,0x64,0x46,0x04,0x00,0x00,
      0x40,0x20,0x1F,0x20,0x44,0x44,0x44,0x44,
      0x44,0x7F,0x44,0x44,0x46,0x64,0x20,0x00,

"接", 0x10,0x10,0x10,0xFF,0x90,0x54,0x44,0x54,
      0xE5,0x46,0x64,0x54,0x46,0x44,0x00,0x00,
      0x02,0x42,0x81,0x7F,0x02,0x02,0x82,0x8A,
      0x57,0x22,0x32,0x4E,0xC2,0x03,0x02,0x00,

"成", 0x00,0x00,0xF8,0x88,0x88,0x88,0x88,0x08,
      0x7F,0x88,0x0A,0x0C,0x08,0xC8,0x00,0x00,
      0x40,0x20,0x1F,0x00,0x08,0x10,0x0F,0x40,
      0x20,0x13,0x1C,0x24,0x43,0x80,0xF0,0x00,

"功", 0x08,0x08,0x08,0xF8,0x0C,0x28,0x20,0x20,
      0xFF,0x20,0x20,0x20,0x20,0xF0,0x20,0x00,
      0x08,0x18,0x08,0x0F,0x84,0x44,0x20,0x1C,
      0x03,0x20,0x40,0x80,0x40,0x3F,0x00,0x00,

"失", 0x00,0x40,0x20,0x1E,0x10,0x10,0x10,0xFF,
      0x10,0x10,0x10,0x18,0x10,0x80,0x00,0x00,
      0x01,0x81,0x81,0x41,0x21,0x11,0x0D,0x03,
      0x0D,0x11,0x21,0x21,0x41,0xC1,0x41,0x00,

"败", 0x00,0xFE,0x02,0xFA,0x02,0xFF,0x02,0x20,
      0x10,0xCF,0x08,0x08,0xF8,0x0C,0x08,0x00,
      0x80,0x47,0x30,0x0F,0x10,0x67,0x80,0x40,
      0x20,0x17,0x08,0x16,0x21,0x60,0x20,0x00
};




void OLED_ShowCHinese(unsigned char  x,unsigned char  y,unsigned char *chn,unsigned char revshow)
{      			    
  unsigned char t,adder=0;
  if(revshow==0)
  {
    OLED_Set_Pos(x,y);	
    for(t=0;t<16;t++)
    {
      WriteDat(*chn++);
      adder+=1;
      
    }	
    OLED_Set_Pos(x,y+1);	
    for(t=0;t<16;t++)
    {	
      WriteDat(*chn++);
      adder+=1;
      
    }
  }else
  {
    OLED_Set_Pos(x,y);	
    for(t=0;t<16;t++)
    {
      WriteDat(~(*chn++));
      adder+=1;
      
    }	
    OLED_Set_Pos(x,y+1);	
    for(t=0;t<16;t++)
    {	
      WriteDat(~(*chn++));
      adder+=1;
      
    }
  }				
}
int PrintHZ(unsigned short  ucY, unsigned short ucX, const unsigned char *ptr, unsigned short ucRevX, unsigned char ucDispMode, unsigned short ucRevLen)
{
  unsigned short Len=0;
  unsigned short i=0;
  unsigned short j=0;
  unsigned short k=sizeof(Hzk)/sizeof(Hzk[0]);
  unsigned char c1,c2;
  unsigned char revyn;
  unsigned char revynchar;
  
  while (ptr[Len]!=0) 
  {
    Len++;
  }	
  while(i<Len)
  {
    c1 = ptr[i];
    c2 = ptr[i+1];
    
    
    if(c1>128)
    {
      for(j=0;j <k;j++)  	
      {
	if(c1 == Hzk[j].Index[0] && c2 == Hzk[j].Index[1])
	{
          break;
	}
      }
      
      if(ucDispMode==1&&(i+ucX)>=ucRevX&&(i+ucX)<ucRevX+2*ucRevLen)
      {
        revyn=1;
      }else
      {
        revyn=0;
      }
      
      if(j==k&&c1!=Hzk[j].Index[0] || c2 != Hzk[j].Index[1])
      {
        
        if((i+ucX)<32)
        {
          OLED_ShowCHinese (i*8+8*ucX,2*ucY,(unsigned char *)&Hzk[0].Msk[0],revyn); //êμ?ú?ò2?μ??í′òó?μúò???oo×?
        }
        
      }else
      {
        
        if((i+ucX)<32)
        {
          OLED_ShowCHinese (i*8+8*ucX,2*ucY,(unsigned char *)&Hzk[j].Msk[0],revyn);
        }
        
      }
      
      i++; 
      
    }else
    {
      if(ucDispMode==1&&(i+ucX)>=ucRevX&&(i+ucX)<ucRevX+ucRevLen)
      {
        revynchar=1;
      }else
      {
        revynchar=0;
      }
      
      if((i+ucX)<32)
      {
        OLED_ShowCharNomAndRev(i*8+8*ucX,2*ucY,ptr[i],revynchar);
      }
    }
    
    i++;//
  }
  return 1;
}
	









